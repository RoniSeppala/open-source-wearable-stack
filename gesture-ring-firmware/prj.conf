## CMakeLists.txt
```
cmake_minimum_required(VERSION 3.20.0)

find_package(Zephyr REQUIRED HINTS $ENV{ZEPHYR_BASE})
project(gesture_ring_firmware)

target_sources(app PRIVATE
    src/main.c
    src/get_all_imu_data.c
    src/gesture_test.c
)

add_subdirectory(drivers)
add_subdirectory(lib)
```

## Kconfig
```
# gesture-ring-firmware/Kconfig

mainmenu "Gesture Ring Firmware"

rsource "drivers/Kconfig"

source "Kconfig.zephyr"
```

## prj.conf
```kconfig
CONFIG_LED_STRIP=y
CONFIG_PULSE_IO=y

CONFIG_I2C=y
CONFIG_SENSOR=y
CONFIG_SENSOR_ICM20602=y
CONFIG_CBPRINTF_FP_SUPPORT=y
```

## app.overlay
```dts
/ {
	aliases {
		led-strip = &rgb_led;
		imu = &my_sensor;
	};
};
```

## dts/bindings/sensor/invensense,icm20602.yaml
```yaml
description: invensense icm-20602 IMU

compatible: "invensense,icm20602"

include: [i2c-device.yaml,sensor-device.yaml]
```

## src/main.c
```c
// SPDX-License-Identifier: MPL-2.0


#include <zephyr/kernel.h>
#include <zephyr/device.h>
#include <zephyr/drivers/led_strip.h>
#include <zephyr/drivers/sensor.h>
#include <stdio.h>

#define LED_NODE DT_ALIAS(led_strip)
#define IMU_NODE DT_ALIAS(imu)

#include "get_all_imu_data.h"
#include "gesture_test.h"

static const struct device *const strip = DEVICE_DT_GET(LED_NODE);
static const struct device *const imu = DEVICE_DT_GET(IMU_NODE);

int main(void)
{
    int err;
    struct led_rgb pixel = {
        .r = 20,
        .g = 0,
        .b = 0,
    };

    if (!device_is_ready(strip)) {
        printf("LED strip not ready\n");
        return 0;
    }

    if (!device_is_ready(imu)) {
        printf("IMU not ready\n");
        return 0;
    }

    struct gyro_data data;
    struct all_gyro_data_int64_t pre_normalisation;
    struct all_imu_data_accel_normalised_float_gyro_int64_t post_normalisation;
    while (1) {

        // led blink
        led_strip_update_rgb(strip, &pixel, 1);

        k_sleep(K_MSEC(50));

        pixel.r = 0;
        pixel.g = 0;
        pixel.b = 0;

        led_strip_update_rgb(strip, &pixel, 1);

        k_sleep(K_MSEC(50));

        pixel.r = 20;

        // accelerometer test

        err = get_all_gyro_data(imu, &data);
        if (err < 0) {
            printf("Channel get error: %d\n", err);
            return -ENODATA;
        }

        gyro_data_sensor_value_to_int64_t(&data, &pre_normalisation);
        acceleration_normalisation(&pre_normalisation, &post_normalisation);
        printf("\r\n\r\n\r\n");

        //printf("Accel x, %d.%06d\r\nAccel y, %d.%06d\r\nAccel z, %d.%06d\r\n\r\nGyro x, %d.%06d\r\nGyro y, %d.%06d\r\nGyro z, %d.%06d\r\n\r\nTemp, %d.%06d\r\n", data.accel_x.val1, data.accel_x.val2, data.accel_y.val1, data.accel_y.val2, data.accel_z.val1, data.accel_z.val2, data.gyro_x.val1, data.gyro_x.val2, data.gyro_y.val1, data.gyro_y.val2, data.gyro_z.val1, data.gyro_z.val2, data.die_temp.val1, data.die_temp.val2);

        printf("Accel x, %.6f\r\nAccel y, %.6f\r\nAccel z, %.6f\r\n\r\nGyro x, %" PRId64 "\r\nGyro y, %" PRId64 "\r\nGyro z, %" PRId64 "\r\n\r\nTemp, %" PRId64 "\r\n", (double)post_normalisation.accel_x, (double)post_normalisation.accel_y, (double)post_normalisation.accel_z, post_normalisation.gyro_x, post_normalisation.gyro_y, post_normalisation.gyro_z, post_normalisation.die_temp);
    }

    return 0;
}
```

## src/gesture_test.c
```c
// SPDX-License-Identifier: MPL-2.0

/* functions by getting confidence values for each gesture by checking how accelerometer/gyro values
 * compare to confidence base
 *
 * returns highest confidence gesture if multiple are over required minimum confidence, and 
 * if none are at required confidence, returns no gesture
*/

#include "gesture_test.h"
#include "get_all_imu_data.h"

#include <zephyr/drivers/sensor.h>
#include <zephyr/device.h>
#include <math.h>
#include <errno.h>
#include <stdio.h>

static int gesture_estimation(struct all_imu_data_accel_normalised_float_gyro_int64_t *imu_data){

    return 0;
}

void acceleration_normalisation(struct all_gyro_data_int64_t *pre_normalisation_data, struct all_imu_data_accel_normalised_float_gyro_int64_t *post_normalisation_data){
    /*
    magnitude = sqrt(ax*ax + ay*ay + az*az);

    gx = ax / magnitude;
    gy = ay / magnitude;
    gz = az / magnitude;
    */

    float accel_x = (float)pre_normalisation_data->accel_x;
    float accel_y = (float)pre_normalisation_data->accel_y;
    float accel_z = (float)pre_normalisation_data->accel_z;

    float magnitude = sqrtf(accel_x*accel_x+accel_y*accel_y+accel_z*accel_z);

    if (magnitude == 0.0f) {
        post_normalisation_data->accel_x = 0.0f;
        post_normalisation_data->accel_y = 0.0f;
        post_normalisation_data->accel_z = 0.0f;
    } else {
        post_normalisation_data->accel_x = pre_normalisation_data->accel_x / magnitude;
        post_normalisation_data->accel_y = pre_normalisation_data->accel_y / magnitude;
        post_normalisation_data->accel_z = pre_normalisation_data->accel_z / magnitude;
    }

    post_normalisation_data->gyro_x = pre_normalisation_data->gyro_x;
    post_normalisation_data->gyro_y = pre_normalisation_data->gyro_y;
    post_normalisation_data->gyro_z = pre_normalisation_data->gyro_z;

    post_normalisation_data->die_temp = pre_normalisation_data->die_temp;
}

void gyro_data_sensor_value_to_int64_t(const struct gyro_data *pre_transform, struct all_gyro_data_int64_t *post_transform){
    post_transform->accel_x = sensor_value_to_micro(&pre_transform->accel_x);
    post_transform->accel_y = sensor_value_to_micro(&pre_transform->accel_y);
    post_transform->accel_z = sensor_value_to_micro(&pre_transform->accel_z);

    post_transform->gyro_x = sensor_value_to_micro(&pre_transform->gyro_x);
    post_transform->gyro_y = sensor_value_to_micro(&pre_transform->gyro_y);
    post_transform->gyro_z = sensor_value_to_micro(&pre_transform->gyro_z);

    post_transform->die_temp = sensor_value_to_micro(&pre_transform->die_temp);
}

int get_gesture(const struct device *imu){
    int err;
    struct gyro_data pre_calibration_data_sensor_value;

    struct all_gyro_data_int64_t pre_calibration_data;
    struct all_imu_data_accel_normalised_float_gyro_int64_t post_calibration_data;

    err = get_all_gyro_data(imu, &pre_calibration_data_sensor_value);
    if (err < 0) {
        printf("Channel get error: %d\n", err);
        return -ENODATA;
    }

    gyro_data_sensor_value_to_int64_t(&pre_calibration_data_sensor_value, &pre_calibration_data);

    acceleration_normalisation(&pre_calibration_data, &post_calibration_data);

    return 0;
}
```

## src/gesture_test.h
```c
#include <zephyr/device.h>
#include "get_all_imu_data.h"

#ifndef GESTURE_TEST_H
#define GESTURE_TEST_H

#define REQUIRED_CONFIDENCE
#define CONFIDENCE_BASE

struct all_gyro_data_int64_t {
    int64_t accel_x;
    int64_t accel_y;
    int64_t accel_z;

    int64_t gyro_x;
    int64_t gyro_y;
    int64_t gyro_z;

    int64_t die_temp;
};

struct all_imu_data_accel_normalised_float_gyro_int64_t {
    float accel_x;
    float accel_y;
    float accel_z;

    int64_t gyro_x;
    int64_t gyro_y;
    int64_t gyro_z;

    int64_t die_temp;
};

void acceleration_normalisation(struct all_gyro_data_int64_t *pre_normalisation_data, struct all_imu_data_accel_normalised_float_gyro_int64_t *post_normalisation_data);
void gyro_data_sensor_value_to_int64_t(const struct gyro_data *pre_transform, struct all_gyro_data_int64_t *post_transform);
int get_gesture(const struct device *imu);

#endif
```

## src/get_all_imu_data.c
```c
// SPDX-License-Identifier: MPL-2.0

#include <zephyr/drivers/sensor.h>
#include <zephyr/device.h>

#include "get_all_imu_data.h"

int get_all_gyro_data(const struct device *imu, struct gyro_data *data){
    int err;

    err = sensor_sample_fetch(imu);
    if (err < 0 ) {
        printf("Sample fetch error: %d\n", err);
        return -ENODATA;
    }

    err = sensor_channel_get (imu, SENSOR_CHAN_ACCEL_X, &data->accel_x);
    if (err < 0) {
        printf("Channel get error: %d\n", err);
        return -ENODATA;
    }
    err = sensor_channel_get (imu, SENSOR_CHAN_ACCEL_Y, &data->accel_y);
    if (err < 0) {
        printf("Channel get error: %d\n", err);
        return -ENODATA;
    }
    err = sensor_channel_get (imu, SENSOR_CHAN_ACCEL_Z, &data->accel_z);
    if (err < 0) {
        printf("Channel get error: %d\n", err);
        return -ENODATA;
    }

    err = sensor_channel_get (imu, SENSOR_CHAN_GYRO_X, &data->gyro_x);
    if (err < 0) {
        printf("Channel get error: %d\n", err);
        return -ENODATA;
    }
    err = sensor_channel_get (imu, SENSOR_CHAN_GYRO_Y, &data->gyro_y);
    if (err < 0) {
        printf("Channel get error: %d\n", err);
        return -ENODATA;
    }
    err = sensor_channel_get (imu, SENSOR_CHAN_GYRO_Z, &data->gyro_z);
    if (err < 0) {
        printf("Channel get error: %d\n", err);
        return -ENODATA;
    }

    err = sensor_channel_get (imu, SENSOR_CHAN_DIE_TEMP, &data->die_temp);
    if (err < 0) {
        printf("Channel get error: %d\n", err);
        return -ENODATA;
    }

    return 0;
}
```

## src/get_all_imu_data.h
```c
// SPDX-License-Identifier: MPL-2.0

#include <zephyr/device.h>
#include <zephyr/drivers/sensor.h>

#ifndef GET_ALL_IMU_DATA_H
#define GET_ALL_IMU_DATA_H

struct gyro_data {
    struct sensor_value accel_x;
    struct sensor_value accel_y;
    struct sensor_value accel_z;

    struct sensor_value gyro_x;
    struct sensor_value gyro_y;
    struct sensor_value gyro_z;

    struct sensor_value die_temp;
};

int get_all_gyro_data(const struct device *imu, struct gyro_data *data);

#endif
```
